// SC431HAI 摄像头驱动（寄存器依据《SC431HAI 数据手册 V1.1》）
//   I2C：7 位地址 0x30（SID 低）/0x32（SID 高），16 位寄存器地址，8 位数据
#include "hal.h"
#include "sc431hai.h"

#define SC_ADDR 0x30

typedef struct { uint16_t reg; uint8_t val; } sc_reg_t;

// 厂商 sc431hai2hdmi_v6 的 i2c_master_reg_rom 配置表（MIPI 4lane RAW10）移植，
// 输出窗口由 1920x1080 改为 1920x1440（4:3，供 3x3 分块去马赛克缩到 640x480），开流移到最后
static const sc_reg_t init_tab[] = {
    {0x0100, 0x00},
    {0x36E9, 0x80},
    {0x37F9, 0x80},
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    {0xFFFF, 0x00},                 // 结束标记
};

int sc431hai_init(void)
{
    uint8_t hi, lo;
    if (hal_i2c_read16(SC_ADDR, 0x3107, &hi) || hal_i2c_read16(SC_ADDR, 0x3108, &lo)) return -1;
    if (hi != 0xCD || lo != 0x6B) return -2;          // SENSOR ID = 0xCD6B
    if (init_tab[0].reg != 0xFFFF) {
        hal_i2c_write16(SC_ADDR, 0x0103, 0x01);        // 软复位
        hal_delay_ms(10);
        for (const sc_reg_t *p = init_tab; p->reg != 0xFFFF; p++)
            if (hal_i2c_write16(SC_ADDR, p->reg, p->val)) return -3;
        hal_i2c_write16(SC_ADDR, 0x0100, 0x01);        // 开流
    }
    return 0;
}

void sc431hai_stream(int on)
{
    // 低功耗软睡眠进出顺序（手册表 1-1）：关流 0x302c=0x0f、0x0100=0；开流 0x302c=0x00、0x0100=1
    hal_i2c_write16(SC_ADDR, 0x302C, on ? 0x00 : 0x0F);
    hal_i2c_write16(SC_ADDR, 0x0100, on ? 0x01 : 0x00);
}

// 曝光：单位半行，范围 4 .. 2*VTS-11（线性模式）；第 N 帧写入、第 N+2 帧生效
void sc431hai_set_exposure(uint32_t half_rows)
{
    if (half_rows < 4) half_rows = 4;
    hal_i2c_write16(SC_ADDR, 0x3E00, (uint8_t)((half_rows >> 12) & 0x0F));
    hal_i2c_write16(SC_ADDR, 0x3E01, (uint8_t)(half_rows >> 4));
    hal_i2c_write16(SC_ADDR, 0x3E02, (uint8_t)((half_rows & 0x0F) << 4));
}

// 模拟增益：粗档 0x00/0x80/0x81/0x83/0x87/0x8F 与细档 0x20..0x3F（手册表 2-7）
void sc431hai_set_again(uint8_t coarse, uint8_t fine)
{
    hal_i2c_write16(SC_ADDR, 0x3E08, coarse);
    hal_i2c_write16(SC_ADDR, 0x3E09, fine);
}
